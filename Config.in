## Config.in
```kconfig
menu "Custom Packages"

source "$NERVES_DEFCONFIG_DIR/package/lora-gateway/Config.in"
source "$NERVES_DEFCONFIG_DIR/package/packet-forwarder/Config.in"
source "$NERVES_DEFCONFIG_DIR/package/lorawan-server/Config.in"

endmenu
```

## package/lorawan-server/Config.in
```kconfig
config BR2_PACKAGE_LORAWAN_SERVER
	bool "lorawan-server"
	default y
	depends on BR2_PACKAGE_PACKET_FORWARDER
	depends on BR2_PACKAGE_ERLANG_21_0
	help
	  Compact server for private LoRaWAN networks

	  https://github.com/gotthardp/lorawan-server
```

## package/packet-forwarder/Config.in
```kconfig
config BR2_PACKAGE_PACKET_FORWARDER
	bool "packet-forwarder"
	default y
	depends on BR2_PACKAGE_LORA_GATEWAY
	help
	  A LoRa packet forwarder is a program running on the host of a LoRa
	  gateway that forwards RF packets received by the concentrator to a server
	  through an IP/UDP link, and emits RF packets that are sent by the server.

	  https://github.com/lora-net/packet_forwarder
```
